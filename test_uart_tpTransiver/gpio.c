/*
 * gpio.c
 *
 *  Created on: Mar 10, 2016
 *      Author: Mohammad Safie //////////////////////
 ////////////////////////
 */
#include "gpio.h"
#include "hw_gpio.h"
#include "hw_types.h"

uint32 init_gpio(gpioObj_t *obj) {

/**************************************************************************************************/
/**************************************************************************************************/
/**************************************************************************************************/
/**************************************************************************************************/
	volatile uint32 dumy = 0;
	if (obj->port == Port_A_APB) {						/******************************************/
		WR_PIN(SYS_BASE + GPIO_CLK, 0, 1);				/******************************************/
	}													/******************************************/
														/******************************************/
	else if (obj->port == Port_B_APB) {					/******************************************/
		WR_PIN(SYS_BASE + GPIO_CLK, 1, 1);				/******************************************/
	}													/******************************************/
														/******************************************/
	else if (obj->port == Port_C_APB) {					/******************************************/
		WR_PIN(SYS_BASE + GPIO_CLK, 2, 1);				/******************************************/
	}													/******************************************/
														/******************************************/
	else if (obj->port == Port_D_APB) {					/******************************************/
			WR_PIN(SYS_BASE + GPIO_CLK, 3, 1);			/******************************************/
		}												/******************************************/
														/******************************************/
	else if (obj->port == Port_E_APB) {					/******************************************/
			WR_PIN(SYS_BASE + GPIO_CLK, 4, 1);			/******************************************/
		}												/******************************************/
														/******************************************/
	else if (obj->port == Port_F_APB) {					/******************************************/
			WR_PIN(SYS_BASE + GPIO_CLK, 5, 1);			/******************************************/
		}												/******************************************/
														/******************************************/
	else if (obj->current == CURRENT_4mA) {				/******************************************/
		WR_PIN(obj->port + R4R_offset, obj->pin, 1);	/******************************************/
	}													/******************************************/
														/******************************************/
	else {return 0;}									/******************************************/
	dumy = 5;


/**************************************************************************************************/
/**************************************************************************************************/

	if (obj->dir){										/******************************************/
		WR_PIN(obj->port + DIR_offset, obj->pin, 1);	/******************************************/
	}													/******************************************/
	else {WR_PIN( obj->port + DIR_offset, obj->pin, 0);	/******************************************/
	}													/******************************************/

/**************************************************************************************************/
/**************************************************************************************************/

	if (obj->AorDtype == digital){						/******************************************/
		WR_PIN( obj->port + AMSEL_offset, obj->pin, 0);	/******************************************/
		WR_PIN( obj->port + DEN_offset, obj->pin, 1);	/******************************************/
	}													/******************************************/
	else if(obj->AorDtype == analoge) {					/******************************************/
		WR_PIN(obj->port + AMSEL_offset, obj->pin, 1);	/******************************************/
		WR_PIN(obj->port + DEN_offset, obj->pin, 0);	/******************************************/
	}													/******************************************/
	else {/*Nothing*/}

/**************************************************************************************************/
/**************************************************************************************************/

	if (obj->DType == GPIO){							/******************************************/
		WR_PIN( obj->port + AFSEL_offset, obj->pin, 0);	/******************************************/
	}													/******************************************/
	else if(obj->DType == Alternative) {				/******************************************/
		WR_PIN(obj->port + AFSEL_offset, obj->pin, 1);	/******************************************/
	}													/******************************************/

/**************************************************************************************************/
/**************************************************************************************************/

	if (obj->PullRes == pullUp){						/******************************************/
		WR_PIN( obj->port + PUR_offset, obj->pin, 1);	/******************************************/
		WR_PIN( obj->port + PDR_offset, obj->pin, 0);	/******************************************/
	}													/******************************************/
	else if(obj->PullRes == pullDown) {					/******************************************/
		WR_PIN(obj->port + PUR_offset, obj->pin, 0);	/******************************************/
		WR_PIN( obj->port + PDR_offset, obj->pin, 1);	/******************************************/
	}													/******************************************/

/**************************************************************************************************/
/**************************************************************************************************/


return 1;}

